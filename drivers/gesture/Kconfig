## drivers/gesture/Kconfig
```kconfig
# Sensor configuration options

# Copyright (c) 2016 Intel Corporation
# SPDX-License-Identifier: Apache-2.0

menuconfig GESTURE
	bool "Gesture sensor drivers"
	help
	  Include sensor drivers in system config

if GESTURE

module = GESTURE
module-str = gesture
source "subsys/logging/Kconfig.template.log_config"

config GESTURE_INIT_PRIORITY
	int "Gesture sensor init priority"
	default 90
	help
	  Gesture sensor initialization priority.

config SENSOR_SHELL_TRIG_PRINT_TIMEOUT_MS
	int "Timeout for printing the average sensor sample value"
	default 5000
	depends on SENSOR_SHELL
	help
	  Control the frequency of the sampling window over which the sensor
	  interrupt handler will collect data.

config SENSOR_INFO
	bool "Sensor Info iterable section"

comment "Device Drivers"

rsource "paj7620/Kconfig"
# source "drivers/gesture/apds9960/Kconfig"

endif # SENSOR
```

## drivers/gesture/paj7620/Kconfig
```kconfig
# Copyright (c) 2017 Intel Corporation
# Copyright (c) 2018 Phytec Messtechnik GmbH
# SPDX-License-Identifier: Apache-2.0

menuconfig PAJ7620
	bool "PAJ7620 Sensor"
	default y
	depends on DT_HAS_PIXART_PAJ7620_ENABLED
	select I2C
	help
	  Enable driver for PAJ7620 sensors.

if PAJ7620

choice
	prompt "Trigger mode"
	default PAJ7620_TRIGGER_NONE
	help
	  Specify the type of triggering used by the driver.

config PAJ7620_TRIGGER_NONE
	bool "No trigger"

config PAJ7620_TRIGGER_GLOBAL_THREAD
	bool "Use global thread"
	depends on GPIO
	select PAJ7620_TRIGGER

endchoice

config PAJ7620_TRIGGER
	bool

endif # PAJ7620
```

## dts/bindings/gesture/avago,apds9960g.yaml
```yaml
description: |
  APDS9960 gesture sensor

compatible: avago,apds9960g

include: [base.yaml, i2c-device.yaml]

properties:

  int-gpios:
    type: phandle-array
    required: true
    description: Interrupt pin
```

## dts/bindings/gesture/pixart,paj7620.yaml
```yaml
description: |
  PAJ7620 gesture sensor

compatible: pixart,paj7620

include: [base.yaml, i2c-device.yaml]

properties:

  int-gpios:
    type: phandle-array
    required: true
    description: Interrupt pin
```

## west.yml
```yaml
# Copyright (c) 2021 Nordic Semiconductor ASA
# SPDX-License-Identifier: Apache-2.0

manifest:
  self:
    path: app

  remotes:
    - name: zephyrproject-rtos
      url-base: https://github.com/zephyrproject-rtos

  defaults:
    remote: zephyrproject-rtos

  projects:
    - name: zephyr
      revision: main
      import:
        name-allowlist:
          - hal_espressif
          - mbedtls
          - lvgl
          - fatfs
    - name: mcuboot
      revision: main
      path: bootloader/mcuboot
    - name: gc9a01-driver
      path: modules/drivers/gc9a01
      url: https://github.com/amrithvenkat12/gc9a01a_zephyr_driver.git
      revision: main
      
```
